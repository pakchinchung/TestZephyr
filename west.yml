## west.yml
```yaml
manifest:
  defaults:
      remote: local-repos

  remotes:
    - name: local-repos
      url-base: file://C:/Developers/F2FZephyr/repos

    - name: zephyr-upstream
      url-base: https://github.com/zephyrproject-rtos

  projects:
    - name: zephyr
      remote: local-repos
      revision: v4.4.0  # Or a specific tag like v3.5.0
      import: 
        name-allowlist:
          - cmsis

    - name: cmsis
      remote: local-repos
      revision: 512cc7e895e8491696b61f7ba8066b4a182569b8
      path: modules/hal/cmsis

    - name: cmsis_6
      remote: local-repos
      revision: 30a859f44ef8ab4dc8f84b03ed586fd16ccf9d74
      path: modules/hal/cmsis_6
      groups:
        - hal

    - name: hal_microchip
      revision: 86f3ea6b389d860332bd81ae8b97543def619395
      path: modules/hal/microchip
      groups:
        - hal

  self:
    path: app
    west-commands: scripts/custom-commands.yml
```
